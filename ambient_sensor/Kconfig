## ambient_sensor/Kconfig
```kconfig
menu "my Ambient sensor Configuration"

config AMBIENT_SENSOR_DEFAULT_SMOOTHING_FACTOR
        int "DEFAULT number of samples in one ADC cycle (oversampling)"
        default 10
        range 5 30
        help
            Define the oversampling number of samples.

config AMBIENT_SENSOR_DEFAULT_DELAY
        int "Default Delay for automatic ambient refresh"
        default 500
        range 100 5000
        help
            delay of the automatic ambient refresh (read adc).

config AMBIENT_SENSOR_MIN_TASK_DELAY
        int "Miminum Allowed Delay for automatic ambient refresh"
        default 1
        range 1 10
        help
            Miminum Allowed Delay for automatic ambient refresh.

config AMBIENT_SENSOR_TASK_DELAY_MAX
        int "Maximum Allowed Delay for automatic ambient refresh"
        default 5
        range 2 20
        help
            Maximum Allowed Delay for automatic ambient refresh.
endmenu
```

## boot_tools/Kconfig
```kconfig
menu "my boot config"
config BOOT_DEFAULT_NUM_REBOOT_FACTORY_RESTORE 
        int "default number of reboots to initiate a factory reset"
        default 4
        range 2 10
        help 
            none             
endmenu
```

## buzzer_class/Kconfig
```kconfig
menu "buzzer Configuration"

config BUZZER_PWM_PIN
        int "Buzzer gpio pin"
        default 25
        range 0 42
        help
            Buzzer gpio pin must support PWL via ledc_channel.

config BUZZER_ENABLE_PIN
        int "Buzzer gpio enable pin"
        default 4
        range 0 42
        help
            Buzzer gpio enable pin.

config BUZZER_DEFAULT_FREQUENCY
        int "Buzzer DEFAULT FREQUENCY"
        default 2000
        range 500 4500
        help
            Buzzer ledc_timer pwm frequency.
			
config BUZZER_ALARM_FREQUENCY
        int "Buzzer Alarm Frequency"
        default 1400
        range 500 4500
        help
            Buzzer Alarm pwm frequency.

config BUZZER_ACK_FREQUENCY
        int "Buzzer Acknowledgment frequency"
        default 1400
        range 500 4500
        help
            Buzzer Acknowledgment pwm frequency.

config BUZZER_ALARM_DUTY
        int "Buzzer alarm intinsity"
        default 2048
        range 0 4095
        help
            Buzzer Alarm intensity :(duty cyle) 2048 = MAX.
			
config BUZZER_ALARM_TIMING_ON
        int "Buzzer ON alarm cycle time"
        default 350
        range 50 1500
        help
            Buzzer ON alarm cycle time (mili seconds).

config BUZZER_ALARM_TIMING_OFF
        int "Buzzer OF alarm cycle time"
        default 100
        range 50 1500
        help
            Buzzer ON alarm cycle time (mili seconds).			

config BUZZER_ACK_DUTY
        int "Buzzer ACK intinsity"
        default 2048
        range 0 4095
        help
            Acknowledgment intensity :(duty cyle) 2048 = MAX.
			
config BUZZER_ACK_TIMING_ON
        int "Buzzer ON Acknowledgment cycle time"
        default 1500
        range 100 2500
        help
            Buzzer ON Acknowledgment cycle time (mili seconds).

config BUZZER_TASK_PRIORITY
        int "task priority"
        default 2
        range 0 30
        help
            Buzzer task priority.			
config BUZZER_TASK_STACK_SIZE
        int "task stack size"
        default 2048
        range 1024 4096
        help
            Buzzer task priority.
config BUZZER_TASK_CORE
        int "task core"
        default 0
        range 0 1
        help
            Buzzer task priority.
endmenu
```

## debug_tools/Kconfig
```kconfig
menu "Aladin Debug Logging Setting"

config AMBIENT_SENSOR_DEFAULT_DELAY
        int "Default Delay for automatic ambient refresh"
        default 500
        range 100 5000
        help
            delay for automatic ambient refresh.

endmenu
```

## mqtt_class/Kconfig
```kconfig
menu "my mqtt Configuration"

config ESP_TLS_SKIP_SERVER_CERT_VERIFY
        bool "ESP_TLS_SKIP_SERVER_CERT_VERIFY"
        default y
        help 
            ESP_TLS_SKIP_SERVER_CERT_VERIFY
config MQTT_DEFAULT_HOSTNAME
        string "host name"
        default "ESP-RAMI"
        help 
            MQTT_DEFAULT_HOSTNAME
config MQTT_DEFAULT_LW_MSG
        string "last will message string"
        default "offline"
        help 
            MQTT_DEFAULT_LW_MSG
config MQTT_DEFAULT_LW_MSG_QOS
        int "last will message QoS"
        default 1
        range 0 3
        help 
            MQTT_DEFAULT_LW_MSG_QOS
config MQTT_DEFAULT_BUFFER_SIZE
        int "Buffer Size"
        default 1024
        range 512 4096
        help 
            MQTT_BUFFER_SIZE
endmenu
```

## ntp_class/Kconfig
```kconfig
menu "my NTP"

config NTP_DEFAULT_SERVER
    string "Server url"
    default "1.europe.pool.ntp.org"
    help
        Define maximum number of partitions that can be mounted.
        
config NTP_MAX_SERVER_COUNT
    int "max server count"
    default 5
    range 1 10
    help
        Define maximum number of partitions that can be mounted.
endmenu
```

## ota_tools/Kconfig
```kconfig
menu "my ota Configuration"

    menu "https ota Configuration"
        config OTA_TASK_PRIORITY
                int "task priority"
                default 2
                range 1 20
                help
                    OTA service task priority.
        config OTA_TASK_STACK_SIZE
                int "task stack size"
                default 8192
                range 2048 8192
                help
                    OTA service task stack size.
        config OTA_TASK_CORE
                int "task core"
                default 1
                range 0 1
                help
                    OTA task core.
        config OTA_HTTPS_DEFAULT_PORT
            int "OTA HTTPS default port"
            default 443
            range 20 9999
            help
                logger task core.

        config OTA_BUFFER_SIZE
            int "buffer size"
            default 4096
            range 1024 8192
            help
                OTA_BUFFER_SIZE.
        config OTA_DELAY_BEFORE_REBOOT_MS
            int "delay before reboot (after flash new fw) ms"
            default 3000
            range 1 10000
            help
                OTA_DELAY_BEFORE_REBOOT_MS.            
        config OTA_RECV_TIMEOUT_MS
            int "http ota recieve timeout"
            default 4000
            range 1000 10000
            help
                OTA_RECV_TIMEOUT_MS.    
        config OTA_DEFAULT_CHECK_DELAY_MINUTES
            int "default check delay in minutes"
            default 600
            range 10 1200
            help
                OTA_DEFAULT_CHECK_DELAY_MINUTES.   
    endmenu

    menu "socket ota Configuration"

    config OTA_SOCKET_TASK_PRIORITY
            int "task priority"
            default 2
            range 1 20
            help
                OTA service task priority.
    config OTA_SOCKET_TASK_STACK_SIZE
            int "stack size"
            default 8192
            range 2048 8192
            help
                OTA_SOCKET service task stack size.
    config OTA_SOCKET_TASK_CORE
            int "task core"
            default 1
            range 0 1
            help
                logger task core.

    config OTA_SOCKET_DEFAULT_PORT
            int "default port"
            default 443
            range 20 9999
            help
                logger task core.


    endmenu
endmenu
```

## storage_tools/Kconfig
```kconfig
menu "additional LittleFS Configuration"

config LittleFS_DEFAULT_PARTITION
        string "default partition name (in the partition table)"
        default "data"
        help
            Define tha name given to the littleFS partition in the csv file

config LittleFS_DEFAULT_PATH
        string "default partition mounting path"
        default "/data"
        help
            Define thadefault partition mounting path : ex /data , so when using fopen("/data/filename.txt")

config LittleFS_FORMAT_IF_FAILED
        int "Format if failed to mount (bool)"
        default 1
        help
            automatically format the partition if failed to mount
config SD_CARD_FREQ
        int "sd card spi bus frequency (khz)"
        default 20000
        range 500 20000
        help 
            default frequency 

endmenu
```

## system_tools/Kconfig
```kconfig
menu "my tasks "

config TASK_DEFAULT_STACK
        int "task default stack size"
        default 2048
        range 512 8192
        help
            STUFF.
config TASK_DEFAULT_PRIORITY 
        int "task default priority"
        default 1 
        range 0 20
        help 
            none             
endmenu
```

## wifi_directory/Kconfig
```kconfig
menu "Wifi Directory Configuration"

    config WIFI_DIRECTORY_READ_BUFFER_SIZE
        int "size of bufffer for reading a line from file system"
        default 1024
        range 512 2048
        help
            size of bufffer for reading a line from file system.

    config WIFI_DIRECTORY_LIST_SIZE
        int "size of wifi list saved in file system"
        default 1024
        range 512 2048
        help
            number of max ssid's can be saved

endmenu
```
